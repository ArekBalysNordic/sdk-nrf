## modules/Kconfig
```kconfig
#
# Copyright (c) 2021 Nordic Semiconductor ASA
#
# SPDX-License-Identifier: LicenseRef-Nordic-5-Clause
#

osource "$(NCS_MEMFAULT_FIRMWARE_SDK_KCONFIG)"
rsource "wfa-qt/Kconfig"
rsource "nrfxlib/nrf_802154_callbacks_dispatcher/Kconfig"
```

## modules/nrfxlib/nrf_802154_callbacks_dispatcher/Kconfig
```kconfig
# Copyright (c) 2026 Nordic Semiconductor
#
# SPDX-License-Identifier: LicenseRef-Nordic-5-Clause
#

config NRF_802154_CALLBACKS_DISPATCHER
	bool "nRF 802.15.4 callbacks dispatcher"
	help
	  This option enables the nRF 802.15.4 callbacks dispatcher.
	  It is used to dispatch callbacks from the nRF 802.15.4 radio driver
	  to the appropriate client.

config NRF_802154_CALLBACKS_DISPATCHER_INIT_PRIORITY
	int "nRF 802.15.4 callbacks dispatcher init priority"
	default 80
	help
	  This option sets the init priority for the nRF 802.15.4 callbacks dispatcher.
```

## modules/openthread/Kconfig
```kconfig
# Copyright (c) 2022 Nordic Semiconductor ASA
# SPDX-License-Identifier: Apache-2.0

# Load the main OpenThread stack Kconfig file
source "$(ZEPHYR_BASE)/modules/openthread/Kconfig"

if OPENTHREAD

config OPENTHREAD_RADIO_DISPATCHER_AUTOREGISTER
	bool "Automatically register the OpenThread stack and radio driver with the nRF 802.15.4 callbacks dispatcher"
	default y
    depends on NRF_802154_CALLBACKS_DISPATCHER
	help
	  Automatically register the OpenThread stack and radio driver with the nRF 802.15.4 callbacks dispatcher.

# Load the nrf-specific OpenThread stack Kconfig file
menu "OpenThread stack nrf features"
rsource "Kconfig.features.nrf"
endmenu

menu "NRF5 radio configuration"
rsource "Kconfig.nrf5"
endmenu

endif # OPENTHREAD
```

## samples/matter/thermostat/Kconfig.sysbuild
```kconfig
#
# Copyright (c) 2023 Nordic Semiconductor ASA
#
# SPDX-License-Identifier: LicenseRef-Nordic-5-Clause
#

source "$(ZEPHYR_NRF_MODULE_DIR)/samples/matter/common/sysbuild/Kconfig"
source "share/sysbuild/Kconfig"
```
