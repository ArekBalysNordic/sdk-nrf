## drivers/flash/Kconfig
```kconfig
if FLASH

# zephyr-keep-sorted-start
rsource "Kconfig.flash_rpc"
rsource "Kconfig.nrf_non_secure"
# zephyr-keep-sorted-stop

endif # FLASH
```

## modules/openthread/Kconfig.features.nrf
```kconfig
# SDK-nrf-specific OpenThread stack features for selection

# Copyright (c) 2025 Nordic Semiconductor ASA
# SPDX-License-Identifier: LicenseRef-Nordic-5-Clause

config OPENTHREAD_RADIO_2P4GHZ_HDR_SUPPORT
	bool "Enable 2.4 GHz HDR PHY (big packet) support"
	depends on OPENTHREAD_SOURCES # For now let's stick to the build from sources
	help
	  Enable High Data Rate (HDR) PHY for big packets. When enabled, the
	  platform radio driver will be called for big-packet send/receive via
	  otPlatRadioTransmitBigPacket and otPlatRadioReceiveBigPacketDone.

choice OPENTHREAD_RADIO_2P4GHZ_HDR_VARIANT
	prompt "2.4 GHz HDR PHY variant"
	default OPENTHREAD_RADIO_2P4GHZ_HDR_VARIANT_1_PHY_ONLY
	depends on OPENTHREAD_RADIO_2P4GHZ_HDR_SUPPORT
	help
	  Choose the 2.4 GHz HDR PHY variant to use.
	  The variant determines the maximum frame size and the fragmentation support.

config OPENTHREAD_RADIO_2P4GHZ_HDR_VARIANT_1_PHY_ONLY
	bool "2.4 GHz HDR PHY variant 1 (phy only)"
	help
	  Use the 2.4 GHz HDR PHY variant 1 (phy only).
	  This variant does not support fragmentation.

config OPENTHREAD_RADIO_2P4GHZ_HDR_VARIANT_2_FRAGMENTATION
	bool "2.4 GHz HDR PHY variant 2 (fragmentation)"
	help
	  Use the 2.4 GHz HDR PHY variant 2 (fragmentation).
	  This variant supports fragmentation.

config OPENTHREAD_RADIO_2P4GHZ_HDR_VARIANT_3_BIG_FRAME
	bool "2.4 GHz HDR PHY variant 3 (big frame)"
	help
	  Use the 2.4 GHz HDR PHY variant 3 (big frame).
	  This variant supports big frames.

endchoice

config OPENTHREAD_RADIO_2P4GHZ_HDR_DRY_RUN
	bool "2.4 GHz HDR PHY dry run"
	depends on OPENTHREAD_RADIO_2P4GHZ_HDR_SUPPORT
	help
	  Use the 2.4 GHz HDR PHY dry run.
	  This will not actually transmit the frame, but will simulate the transmission.

choice OPENTHREAD_PSA_NVM_BACKEND
	prompt "Backend to store persistent crypto materials"
	default OPENTHREAD_PSA_NVM_BACKEND_ITS
	depends on OPENTHREAD_CRYPTO_PSA

config OPENTHREAD_PSA_NVM_BACKEND_ITS
	bool "Use Internal Trusted Storage (ITS) for storing crypto materials."
	depends on OPENTHREAD_CRYPTO_PSA
	help
	  Store cryptographic materials in the PSA ITS.
	  The PSA ITS location depends on the ITS configuration.

config OPENTHREAD_PSA_NVM_BACKEND_KMU
	bool "Use CRACEN KMU driver for storing crypto materials [EXPERIMENTAL]."
	depends on PSA_NEED_CRACEN_KMU_DRIVER
	select EXPERIMENTAL
	help
	  Store cryptographic materials in the Key Management Unit space instead of PSA ITS.
	  The materials will be used by CRACEN driver.
	  KMU slots range is defined as <OPENTHREAD_KMU_SLOT_START, OPENTHREAD_KMU_SLOT_END).
	  Keys are not encrypted in KMU.

endchoice # OPENTHREAD_PSA_NVM_BACKEND

config OPENTHREAD_PSA_ITS_NVM_OFFSET
	hex "Offset of IDs for OpenThread keys stored in the PSA ITS."
	default 0x20000
	help
	  The offset value in the PSA ITS non-volatile space is dedicated to OpenThread
	  key reference IDs. This offset must not overwrite any other ranges already in
	  use within the PSA ITS non-volatile space.

config OPENTHREAD_PSA_ITS_NVM_MAX_KEYS
	int "Maximum ITS key reference amount to be assigned"
	default 20
	help
	  The maximum ITS key reference amount that can be assigned for OpenThread crypto
	  materials.

if OPENTHREAD_PSA_NVM_BACKEND_KMU

config OPENTHREAD_KMU_SLOT_START
	int "OpenThread crypto materials KMU slot range start"
	default 80
	help
	  The first KMU slot number under which the OpenThread crypto materials will be stored.
	  The range defined by OPENTHREAD_KMU_SLOT_START must not overlap any other KMU slot
	  range defined within the application. The slot amount dedicated for OpenThread is
	  defined in the crypto_psa_key_allocator and can be modified according to changes in
	  the OpenThread stack.

endif # OPENTHREAD_PSA_NVM_BACKEND_KMU
```

## samples/matter/TAS_example/Kconfig
```kconfig
#
# Copyright (c) 2023 Nordic Semiconductor ASA
#
# SPDX-License-Identifier: LicenseRef-Nordic-5-Clause
#

source "Kconfig.zephyr"
source "${ZEPHYR_BASE}/../modules/lib/matter/config/nrfconnect/chip-module/Kconfig.features"
source "${ZEPHYR_BASE}/../modules/lib/matter/config/nrfconnect/chip-module/Kconfig.defaults"

config CHIP_DEVICE_VENDOR_ID
	int "Vendor id"
	default 65521
	help
	  By default product ID is set to 65521.
	  This is lock app vendor ID

config CHIP_DEVICE_PRODUCT_ID
	int "Product id"
	default 32774
	help
	  By default product ID is set to 32774.
	  This is lock app product ID

config BOARD_ENABLE_CPUNET
	bool
	default y if (BOARD_NRF5340DK_NRF5340_CPUAPP || BOARD_NRF7002DK_NRF5340_CPUAPP)

config CHIP_OTA_IMAGE_FILE_NAME
	string "default filename for OTA"
	default "matter.ota"
```

## samples/matter/common/src/Kconfig
```kconfig
#
# Copyright (c) 2023 Nordic Semiconductor
#
# SPDX-License-Identifier: LicenseRef-Nordic-5-Clause
#

config NCS_SAMPLE_MATTER_APP_TASK_QUEUE_SIZE
	int "Maximum amount of tasks delegated to be run in the application queue"
	default 10
	help
	  Define the maximum size of the queue dedicated for application tasks that
	  have to be run in the application thread context.

config NCS_SAMPLE_MATTER_APP_TASK_MAX_SIZE
	int "Maximum size of application task in bytes"
	default 16
	help
	  Defines the maximum size of a functor that can be put in the application
	  thread's task queue.

config NCS_SAMPLE_MATTER_CUSTOM_BLUETOOTH_ADVERTISING
	bool "Define the custom behavior of the Bluetooth advertisement in the application code"
	help
	  Disable the default Bluetooth advertising start which is defined in the board.cpp file and
	  allow to use the custom one.

config NCS_SAMPLE_MATTER_OPERATIONAL_KEYS_MIGRATION_TO_ITS
	bool "Enable operational keys migration feature"
	depends on CHIP_CRYPTO_PSA
	help
	  Enables migration of the operational keys stored in the persistent storage to the PSA ITS secure storage.
	  Enable this feature while updating the firmware of in-field devices that run Mbed TLS cryptography backend
	  to the firmware based on PSA Crypto API.

config NCS_SAMPLE_MATTER_FACTORY_RESET_ON_KEY_MIGRATION_FAILURE
	bool "Perform factory reset if the operational key migration failed"
	default y
	depends on NCS_SAMPLE_MATTER_OPERATIONAL_KEYS_MIGRATION_TO_ITS
	help
	  Allow device to perform factory reset if the operational key for Fabric has not been migrated
	  properly to PSA ITS storage.

config NCS_SAMPLE_MATTER_LEDS
	bool "Enable LEDs usage"
	default y
	depends on DK_LIBRARY
	help
	  Enables LEDs module to be used in the application.

config NCS_SAMPLE_MATTER_SETTINGS_SHELL
	bool "Settings shell for Matter purposes"
	default y if CHIP_MEMORY_PROFILING
	depends on SHELL
	depends on NVS || ZMS
	help
	  Allows using matter_settings shell commands.
	  You can use the following commands:
	  peak - to read the maximum settings usage.
	  reset - to reset peak value.
	  get_size - to read the size of specific value.
	  current - to read current settings usage.
	  free - to read free settings space.

config NCS_SAMPLE_MATTER_TEST_EVENT_TRIGGERS
	bool "Test event triggers support"
	default y
	help
	  Enables support for test event triggers for the specific use-cases.

config NCS_SAMPLE_MATTER_TEST_EVENT_TRIGGERS_MAX
	int "Maximum amount of event triggers"
	default 8
	depends on NCS_SAMPLE_MATTER_TEST_EVENT_TRIGGERS
	help
	  Defines the maximum amount of event triggers.

config NCS_SAMPLE_MATTER_TEST_EVENT_TRIGGERS_REGISTER_DEFAULTS
	bool "Register default triggers for Matter sample"
	depends on NCS_SAMPLE_MATTER_TEST_EVENT_TRIGGERS
	default y
	help
	  Automatically register default triggers such as factory reset,
	  device reboot, OTA start query.

config NCS_SAMPLE_MATTER_TEST_EVENT_TRIGGERS_MAX_TRIGGERS_DELEGATES
	int "Maximum amount of the trigger delegates"
	default 2
	depends on NCS_SAMPLE_MATTER_TEST_EVENT_TRIGGERS
	help
	  Defines the maximum number for the TestEventTriggerDelegate implementations
	  to be registered in the nRF test event triggers class.

config NCS_SAMPLE_MATTER_TEST_SHELL
	bool "Test - specific shell commands support for Matter samples"
	depends on CHIP_LIB_SHELL
	help
	  Enables support for test - specific shell commands in Matter samples.

config NCS_SAMPLE_MATTER_PERSISTENT_STORAGE
	bool "Persistent storage support for Matter samples"
	help
	  Matter persistent storage support with the configurable backend.

config NCS_SAMPLE_MATTER_ZAP_FILE_PATH
	string "Path in sample, under which ZAP file is located"
	help
	  Absolute path to location under which ZAP file is located.
	  It shall contain the file name and .zap extension.

config NCS_SAMPLE_MATTER_CERTIFICATION
	bool "Enable patches required for Matter platform certification"
	help
	  It enables including software patches required for the Matter platform certification
	  purposes. Currently it works only with the Matter template sample.

choice NCS_SAMPLE_MATTER_ZAP_GENERATION_METHOD
	prompt "Method to generate the IDL"
	default NCS_SAMPLE_MATTER_ZAP_GENERATION_STATIC
	help
	  This option will select the method to generate the Matter data model.

config NCS_SAMPLE_MATTER_ZAP_GENERATION_STATIC
	bool "Use static pre-generated ZAP files from the samples directory"
	help
	  This option will use the static ZAP pre-generated files in the samples directory.
	  This option does not require zap-cli to be installed and available in the PATH.

config NCS_SAMPLE_MATTER_ZAP_GENERATION_BUILD_TIME
	bool "Generate ZAP files at build time"
	help
	  This option will generate the ZAP files according to the provided .zap file at build time.
	  This option requires zap-cli to be installed and available in the PATH.

endchoice

config NCS_SAMPLE_MATTER_DOWNLOAD_ZAP_CLI
	bool "Download the approperiate version of zap-cli"
	default y if NCS_SAMPLE_MATTER_ZAP_GENERATION_BUILD_TIME
	help
	  This option will download zap-cli if it is not present in the system.

rsource "persistent_storage/Kconfig"
rsource "watchdog/Kconfig"
rsource "diagnostic/Kconfig"
```

## samples/matter/common/src/diagnostic/Kconfig
```kconfig
#
# Copyright (c) 2024 Nordic Semiconductor
#
# SPDX-License-Identifier: LicenseRef-Nordic-5-Clause
#

menuconfig NCS_SAMPLE_MATTER_DIAGNOSTIC_LOGS
	bool "Enable diagnostics logs support"
	help
	  Provides support for diagnostics logs. Diagnostics logs allow the Matter controller to read end-user,
	  network and crash logs from the Matter device.
	  Diagnostic logs are usable only if the DiagnosticCluster is available and active on the device's root endpoint.
	  Otherwise the compilation error occurs.

if NCS_SAMPLE_MATTER_DIAGNOSTIC_LOGS

config NCS_SAMPLE_MATTER_DIAGNOSTIC_LOGS_MAX_SIMULTANEOUS_SESSIONS
	int "Define maximum simultaneous sessions"
	default 20
	help
	  The maximum simultaneous sessions, which is the capability for sending diagnostic logs
	  to Matter controller using multiple sessions at the same time for different diagnostic
	  intents. When a session finishes, it releases its slot for a new one.

config NCS_SAMPLE_MATTER_DIAGNOSTIC_LOGS_CRASH_LOGS
	bool "Crash logs support"
	select RETAINED_MEM
	select RETENTION
	select RETENTION_MUTEX_FORCE_DISABLE
	select RETAINED_MEM_MUTEX_FORCE_DISABLE
	help
	  Enables support for storing crash logs when the crash occurs.

if NCS_SAMPLE_MATTER_DIAGNOSTIC_LOGS_CRASH_LOGS

config NCS_SAMPLE_MATTER_DIAGNOSTIC_LOGS_REMOVE_CRASH_AFTER_READ
	bool "Remove the last crash data after read"
	help
	  Removes the last crash data after reading it by Matter controller.
	  Disable this option to read the last crash multiple times.

config NCS_SAMPLE_MATTER_DIAGNOSTIC_LOGS_SAVE_CRASH_TO_SETTINGS
	bool "Save crash logs to settings storage"
	help
	  Saves crash logs to settings storage at the boot time if there is an entry in the retention memory.
	  If this option is disabled crash logs will be saved only in the retention memory and can be lost
	  during physical power down.

endif # NCS_SAMPLE_MATTER_DIAGNOSTIC_LOGS_CRASH_LOGS
endif # NCS_SAMPLE_MATTER_DIAGNOSTIC_LOGS
```

## samples/matter/common/src/event_triggers/Kconfig
```kconfig
#
# Copyright (c) 2024 Nordic Semiconductor
#
# SPDX-License-Identifier: LicenseRef-Nordic-5-Clause
#

menuconfig NCS_SAMPLE_MATTER_TEST_EVENT_TRIGGERS
	bool "Test event triggers support"
	help
	  Enables support for test event triggers for the specific use-cases.
```

## samples/matter/template/boards/nrf54l15pdk_nrf54l15_cpuapp.conf
```kconfig
#
# Copyright (c) 2024 Nordic Semiconductor ASA
#
# SPDX-License-Identifier: LicenseRef-Nordic-5-Clause
#

CONFIG_CHIP_NFC_COMMISSIONING=n
CONFIG_CHIP_OTA_REQUESTOR=n
CONFIG_CHIP_QSPI_NOR=n
CONFIG_CHIP_LIB_SHELL=y

CONFIG_BT_LL_SOFTDEVICE_MULTIROLE=y

# Disable DFU
CONFIG_CHIP_OTA_REQUESTOR=n
CONFIG_CHIP_QSPI_NOR=n
CONFIG_CHIP_NFC_COMMISSIONING=n

CONFIG_FPROTECT=n
CONFIG_LOG_MODE_DEFERRED=y
CONFIG_FPU=n
CONFIG_PM=n
CONFIG_HWINFO_NRF=n

CONFIG_NRF_802154_TEMPERATURE_UPDATE=n

# disable factory data
CONFIG_CHIP_FACTORY_DATA=n
CONFIG_CHIP_FACTORY_DATA_BUILD=n

# disable CRACEN and switch to OBERON for now
CONFIG_PSA_CRYPTO_DRIVER_OBERON=n

# CONFIG_PSA_USE_CRACEN_KEY_MANAGEMENT_DRIVER=n # Disable ECC_SECP_R1_256 [SPAKE | PASE]
# CONFIG_PSA_USE_CRACEN_ASYMMETRIC_DRIVER=n # Disable ECDSA [Certificates]
# CONFIG_PSA_USE_CRACEN_MAC_DRIVER=n # Disable CMAC/HMAC [Secure session]
# CONFIG_PSA_USE_CRACEN_KEY_AGREEMENT_DRIVER=n # disable ECDH_SECP_R1_256 [CASE]
```

## samples/matter/template/boards/nrf54l15pdk_nrf54l15_cpuapp_release.conf
```kconfig
#
# Copyright (c) 2024 Nordic Semiconductor ASA
#
# SPDX-License-Identifier: LicenseRef-Nordic-5-Clause
#

CONFIG_CHIP_NFC_COMMISSIONING=n
CONFIG_CHIP_OTA_REQUESTOR=n
CONFIG_CHIP_QSPI_NOR=n

CONFIG_BT_MAX_CONN=1
CONFIG_BT_LL_SOFTDEVICE_MULTIROLE=y

# Disable DFU
CONFIG_CHIP_QSPI_NOR=n
CONFIG_CHIP_NFC_COMMISSIONING=n

# Lack of Fprotect support
CONFIG_FPROTECT=n
CONFIG_CHIP_FACTORY_DATA_WRITE_PROTECT=n

CONFIG_FPU=n
CONFIG_PM=n
CONFIG_HWINFO_NRF=n

CONFIG_NRF_802154_TEMPERATURE_UPDATE=n

# disable CRACEN and switch to OBERON for now
CONFIG_PSA_CRYPTO_DRIVER_OBERON=n
```

## samples/openthread/cli/snippets/low_power/boards/nrf54l15pdk_nrf54l15_cpuapp.conf
```kconfig
#
# Copyright (c) 2024 Nordic Semiconductor
#
# SPDX-License-Identifier: LicenseRef-Nordic-5-Clause
#

CONFIG_POWEROFF=y
CONFIG_RAM_POWER_DOWN_LIBRARY=n
CONFIG_SOC_NRF_FORCE_CONSTLAT=n
```

## samples/openthread/coprocessor/Kconfig.sysbuild
```kconfig
#
# Copyright (c) 2026 Nordic Semiconductor ASA
#
# SPDX-License-Identifier: LicenseRef-Nordic-5-Clause
#

# Do not use partition manager on nRF52840 dongle.
config PARTITION_MANAGER
	default n if BOARD_NRF52840DONGLE_NRF52840

source "share/sysbuild/Kconfig"
```

## samples/tfm/tfm_hello_world/boards/nrf54l15pdk_nrf54l15_cpuapp_ns.conf
```kconfig
#
# Copyright (c) 2024 Nordic Semiconductor ASA
#
# SPDX-License-Identifier: LicenseRef-Nordic-5-Clause
#

# Multirole is the only currently supported role by SoftDevice.
CONFIG_BT_LL_SOFTDEVICE_MULTIROLE=y

CONFIG_FPU=n
CONFIG_PM=n
CONFIG_HWINFO_NRF=n

CONFIG_NRF_802154_TEMPERATURE_UPDATE=n

# nRF54L15 requires bigger stack sizes than nRF52/nRF53 families
CONFIG_CHIP_MALLOC_SYS_HEAP_SIZE=10240
CONFIG_MPSL_WORK_STACK_SIZE=2048
```
