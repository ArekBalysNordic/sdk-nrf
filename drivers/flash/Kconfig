## subsys/nrf_security/src/drivers/cracen/Kconfig
```kconfig
#
# Copyright (c) 2023 Nordic Semiconductor
#
# SPDX-License-Identifier: LicenseRef-Nordic-5-Clause
#

config CRACEN_HW_PRESENT
	def_bool SOC_SERIES_NRF54LX

# Configure CRACEN_LOG_LEVEL
module = CRACEN
module-str = CRACEN
source "${ZEPHYR_BASE}/subsys/logging/Kconfig.template.log_config"

if PSA_CRYPTO_DRIVER_CRACEN

config CRACEN_LOAD_MICROCODE
	bool "Load CRACEN microcode"
	depends on (SOC_SERIES_NRF54LX && !SOC_NRF54L20) || SOC_SERIES_NRF54HX
	default y
	help
	  Prompt-less configuration to load the CRACEN microcode.
	  This is required to use the PKE/IKG engine. Note that this is not
	  required when a bootloader has already loaded the microcode.

config CRACEN_LIB_KMU
	bool "CRACEN KMU library"
	depends on SOC_SERIES_NRF54LX
	select NRFX_RRAMC if !BUILD_WITH_TFM
	default y
	help
	  The CRACEN KMU library.

if CRACEN_LIB_KMU

config CRACEN_TRANSLATE_ITS_TO_KMU
	bool "Translate all PSA keys to KMU slots"
	help
	  It will translate all PSA ITS keys to KMU slots if the range is defined.
	  To use it you need to register a range to be translated, and specify the
	  maximum number of keys. If it is enabled the ITS won't be used and all keys
	  that are created by psa_generate_key or imported by psa_import_key will be
	  stored in KMU automatically if the slot is available.

config CRACEN_TRANSLATE_ITS_TO_KMU_ENCRYPTION
	bool "Encrypt all PSA keys before translating to KMU"
	depends on CRACEN_TRANSLATE_ITS_TO_KMU
	help
	  Encrypt all PSA keys before translating them to KMU slots.
	  This operation will require two additional slots in KMU for each key.

config CRACEN_TRANSLATE_ITS_TO_KMU_MAX_RANGES
	int "Maximum number of ranges to translate"
	depends on CRACEN_TRANSLATE_ITS_TO_KMU
	range 1 10
	default 3
	help
	  The maximum number of ranges to translate from PSA ITS to KMU slots.

config CRACEN_IKG_SEED_LOAD
	bool "Load the CRACEN IKG seed"
	default y
	help
	  The IKG seed is used to derive the keys in the IKG.
	  If there is no seed in KMU, it is expected to be generated.
	  Note that this is not required to be used if a bootloader is loading
	  KMU seed.

config CRACEN_IKG_SEED_KMU_SLOT
	int "KMU slot of the CRACEN IKG seed"
	range 0 183
	default 183
	help
	  The CRACEN IKG seed spans over 3 KMU slots:
	  the one defined here and the two subsequent ones.
	  This defines the KMU slot (along with the two following it) to which
	  the IKG seed is provisioned and that is pushed when loading the IKG seed.

endif # CRACEN_LIB_KMU

rsource 'psa_driver.Kconfig'

endif # PSA_CRYPTO_DRIVER_CRACEN
```

## sysbuild/Kconfig.matter
```kconfig
# Copyright (c) 2024 Nordic Semiconductor
#
# SPDX-License-Identifier: LicenseRef-Nordic-5-Clause

menuconfig MATTER
	bool "Matter"
	depends on ZEPHYR_CONNECTEDHOMEIP_MODULE

if MATTER

config MATTER_FACTORY_DATA_GENERATE
	bool "Create matter factory data"
	help
	  Generate Matter factory data set and the HEX file for the sample during the building
	  process.

config MATTER_FACTORY_DATA_MERGE_WITH_FIRMWARE
	bool "Merge generated factory data with merged.hex output"
	depends on MATTER_FACTORY_DATA_GENERATE
	default y
	help
	  Enables merging the generated factory data with the merged.hex output build file. As a
	  result, the merged.hex build output file, which is used when flashing the firmware using
	  the west tool, includes the factory data as well.

config MATTER_OTA
	bool "Matter OTA Software Update"
	default y
	help
	  Enables over-the-air (OTA) Requestor role that allows the node to perform Device Firmware
	  Update by querying and downloading a new firmware image from a peer OTA Provider node.

config MATTER_OTA_IMAGE_FILE_NAME
	string "OTA image file name"
	default "matter.ota"
	depends on MATTER_OTA
	help
	  Provides the file name of the generated Matter OTA image in the build directory.

config MATTER_SUIT_COMMON_MANIFESTS
	bool "Use the common Matter manifests for SUIT"
	default y if SOC_SERIES_NRF54HX
	depends on SUIT_ENVELOPE
	help
	  Use the common suit manifests that are located in the Matter samples common
	  directory in the suit_templates sub-directory.

choice MATTER_SUIT_IMAGE
	prompt "Select the SUIT root manifest depending on the purpose"
	depends on MATTER_SUIT_COMMON_MANIFESTS
	help
	  Choose which images will be included in the root manifest and
	  installed during the firmware update. This option is available only
	  for the common Matter Suit manifests.

	config MATTER_SUIT_IMAGE_ALL
		bool "Both application and radio images"
		help
		  The Suit root manifest will include and install both application
		  and Radio core images. Both images will be installed during the
		  DFU process.

	config MATTER_SUIT_IMAGE_APP_ONLY
		bool "The application core image only"
		help
		  The Suit root manifest will include and install only the new application image.
		  It means that the current radio core image installed on the board must be
		  compatible with the new application image.

	config MATTER_SUIT_IMAGE_RAD_ONLY
		bool "The radio core image only"
		help
		  The Suit root manifest will include and install only the new radio image.
		  It means that the current application core image installed on the board
		  must be compatible with the new radio image.

endchoice

if MATTER_SUIT_IMAGE_ALL

config SUIT_ENVELOPE_ROOT_TEMPLATE
	default "../common/suit_templates/root_with_binary_nordic_top.yaml.jinja2"

endif

if MATTER_SUIT_IMAGE_APP_ONLY

config SUIT_ENVELOPE_ROOT_TEMPLATE
	default "../common/suit_templates/root_with_binary_nordic_top_app.yaml.jinja2"

endif

if MATTER_SUIT_IMAGE_RAD_ONLY

config SUIT_ENVELOPE_ROOT_TEMPLATE
	default "../common//suit_templates/root_with_binary_nordic_top_rad.yaml.jinja2"

endif

endif
```

## tests/subsys/dfu/dfu_target/suit/testcase.yaml
```yaml
tests:
  dfu.dfu_target.suit:
    sysbuild: true
    platform_allow: nrf54h20dk/nrf54h20/cpuapp
    integration_platforms:
      - nrf54h20dk/nrf54h20/cpuapp
    tags: dfu sysbuild ci_tests_subsys_dfu
```
