/*
 * Copyright (c) 2025 Nordic Semiconductor ASA
 *
 * SPDX-License-Identifier: LicenseRef-Nordic-5-Clause
 */

#include <samples/matter/nrf5340_partitions.dtsi>

/* Disable GPIO forwarder for nRF7002 EK compatibility */
&gpio_fwd {
	status = "disabled";
};

/ {
	chosen {
		zephyr,code-partition = &boot_partition;
	};
};
