/*
 * Copyright (c) 2023 Nordic Semiconductor ASA
 *
 * SPDX-License-Identifier: Apache-2.0
 */

/ {
	chosen {
		zephyr,console = &uart30;
		zephyr,shell-uart = &uart30;
	};
};

&uart30 {
	status = "okay";
};


/* Workaround for nRF54L15 PDK in revision 0.2.x
TODO: remove the following lines for PDK in higher revisions
*/
/delete-node/ &button2;
/delete-node/ &button3;
/ {
    aliases {
        /delete-property/ sw2;
        /delete-property/ sw3;
    };
};
