## Kconfig
```
#
# Copyright (c) 2020 Nordic Semiconductor ASA
#
# SPDX-License-Identifier: LicenseRef-Nordic-5-Clause
#

menu "Zephyr Kernel"
source "Kconfig.zephyr"
endmenu

module = OT_COMMAND_LINE_INTERFACE
module-str = ot_cli
source "$(ZEPHYR_BASE)/subsys/logging/Kconfig.template.log_config"

config CLI_SAMPLE_LOW_POWER
	bool "Low power mode for the CLI sample"

config CLI_SAMPLE_MULTIPROTOCOL
	bool "Multiprotocol for the CLI sample"

config CLI_SAMPLE_AUTOSTART
	bool "Autostart Thread network"
```

## Kconfig.sysbuild
```
#
# Copyright (c) 2024 Nordic Semiconductor ASA
#
# SPDX-License-Identifier: LicenseRef-Nordic-5-Clause
#

source "${ZEPHYR_BASE}/share/sysbuild/Kconfig"

config NRF_DEFAULT_IPC_RADIO
	default y

config PARTITION_MANAGER
	default y if SOC_SERIES_NRF54LX
```

## sample.yaml
```
sample:
  name: OpenThread CLI sample
  description: Test OpenThread Command Line Interface.

tests:
  sample.openthread.cli.hdr_v1:
    sysbuild: true
    build_only: true
    tags:
      - ci_build
      - sysbuild
      - ci_samples_openthread
    platform_allow:
      - nrf54l15dk/nrf54l15/cpuapp
      - nrf54lm20dk/nrf54lm20a/cpuapp
      - nrf52840dk/nrf52840
    extra_args:
      - EXTRA_CONF_FILE="hdr_test.conf"
    integration_platforms:
      - nrf54l15dk/nrf54l15/cpuapp
      - nrf54lm20dk/nrf54lm20a/cpuapp
      - nrf52840dk/nrf52840
  sample.openthread.cli.hdr_v2:
    sysbuild: true
    build_only: true
    tags:
      - ci_build
      - sysbuild
      - ci_samples_openthread
    platform_allow:
      - nrf54l15dk/nrf54l15/cpuapp
      - nrf54lm20dk/nrf54lm20a/cpuapp
      - nrf52840dk/nrf52840
    extra_args:
      - EXTRA_CONF_FILE="hdr_test.conf"
      - CONFIG_OPENTHREAD_RADIO_2P4GHZ_HDR_VARIANT_2_FRAGMENTATION=y
    integration_platforms:
      - nrf54l15dk/nrf54l15/cpuapp
      - nrf54lm20dk/nrf54lm20a/cpuapp
      - nrf52840dk/nrf52840
  sample.openthread.cli.hdr_v3:
    sysbuild: true
    build_only: true
    tags:
      - ci_build
      - sysbuild
      - ci_samples_openthread
    platform_allow:
      - nrf54l15dk/nrf54l15/cpuapp
      - nrf54lm20dk/nrf54lm20a/cpuapp
      - nrf52840dk/nrf52840
    extra_args:
      - EXTRA_CONF_FILE="hdr_test.conf"
      - CONFIG_OPENTHREAD_RADIO_2P4GHZ_HDR_VARIANT_3_BIG_FRAME=y
    integration_platforms:
      - nrf54l15dk/nrf54l15/cpuapp
      - nrf54lm20dk/nrf54lm20a/cpuapp
      - nrf52840dk/nrf52840
  sample.openthread.cli:
    sysbuild: true
    build_only: true
    tags:
      - ci_build
      - sysbuild
      - ci_samples_openthread
    platform_allow:
      - nrf52840dk/nrf52840
      - nrf52840dongle/nrf52840
      - nrf21540dk/nrf52840
      - nrf5340dk/nrf5340/cpuapp
      - nrf54l15dk/nrf54l15/cpuapp
      - nrf54l15dk/nrf54l10/cpuapp
      - nrf54l15dk/nrf54l15/cpuapp/ns
      - nrf54lm20dk/nrf54lm20a/cpuapp
    integration_platforms:
      - nrf52840dk/nrf52840
      - nrf52840dongle/nrf52840
      - nrf21540dk/nrf52840
      - nrf5340dk/nrf5340/cpuapp
      - nrf54l15dk/nrf54l15/cpuapp
      - nrf54l15dk/nrf54l10/cpuapp
      - nrf54l15dk/nrf54l15/cpuapp/ns
      - nrf54lm20dk/nrf54lm20a/cpuapp
  sample.openthread.cli.multiprotocol:
    sysbuild: true
    build_only: true
    tags:
      - ci_build
      - sysbuild
      - ci_samples_openthread
    platform_allow:
      - nrf52840dk/nrf52840
      - nrf52840dongle/nrf52840
      - nrf21540dk/nrf52840
      - nrf5340dk/nrf5340/cpuapp
      - nrf54l15dk/nrf54l15/cpuapp
      - nrf54l15dk/nrf54l10/cpuapp
      - nrf54l15dk/nrf54l15/cpuapp/ns
      - nrf54lm20dk/nrf54lm20a/cpuapp
    extra_args:
      - cli_SNIPPET="ci;logging;multiprotocol;tcp"
      - CONFIG_OTPERF=y
      - FILE_SUFFIX=ble
    integration_platforms:
      - nrf52840dk/nrf52840
      - nrf52840dongle/nrf52840
      - nrf21540dk/nrf52840
      - nrf5340dk/nrf5340/cpuapp
      - nrf54l15dk/nrf54l15/cpuapp
      - nrf54l15dk/nrf54l10/cpuapp
      - nrf54l15dk/nrf54l15/cpuapp/ns
      - nrf54lm20dk/nrf54lm20a/cpuapp
  sample.openthread.cli.singleprotocol:
    sysbuild: true
    build_only: true
    tags:
      - ci_build
      - sysbuild
      - ci_samples_openthread
    platform_allow:
      - nrf52840dk/nrf52840
      - nrf21540dk/nrf52840
      - nrf5340dk/nrf5340/cpuapp
      - nrf54l15dk/nrf54l15/cpuapp
      - nrf54l15dk/nrf54l10/cpuapp
      - nrf54l15dk/nrf54l15/cpuapp/ns
    extra_args:
      - cli_SNIPPET="ci;logging;tcp"
      - CONFIG_OTPERF=y
    integration_platforms:
      - nrf52840dk/nrf52840
      - nrf21540dk/nrf52840
      - nrf5340dk/nrf5340/cpuapp
      - nrf54l15dk/nrf54l15/cpuapp
      - nrf54l15dk/nrf54l10/cpuapp
      - nrf54l15dk/nrf54l15/cpuapp/ns
  sample.openthread.cli.usb:
    sysbuild: true
    build_only: true
    tags:
      - ci_build
      - sysbuild
      - ci_samples_openthread
    platform_allow:
      - nrf52840dk/nrf52840
      - nrf21540dk/nrf52840
      - nrf5340dk/nrf5340/cpuapp
    extra_args:
      - cli_SNIPPET="ci;logging;multiprotocol;tcp;usb"
      - FILE_SUFFIX=ble
    integration_platforms:
      - nrf52840dk/nrf52840
      - nrf21540dk/nrf52840
      - nrf5340dk/nrf5340/cpuapp
  sample.openthread.cli.low_power:
    sysbuild: true
    build_only: true
    tags:
      - ci_build
      - sysbuild
      - ci_samples_openthread
    platform_allow:
      - nrf52840dk/nrf52840
      - nrf5340dk/nrf5340/cpuapp
      - nrf54l15dk/nrf54l15/cpuapp
      - nrf54lm20dk/nrf54lm20a/cpuapp
    extra_args:
      - cli_SNIPPET="ci;low_power"
      - CONFIG_OTPERF=y
    integration_platforms:
      - nrf52840dk/nrf52840
      - nrf5340dk/nrf5340/cpuapp
      - nrf54l15dk/nrf54l15/cpuapp
      - nrf54lm20dk/nrf54lm20a/cpuapp
  # Build integration regression protection.
  sample.nrf_security.openthread.integration:
    sysbuild: true
    build_only: true
    tags:
      - sysbuild
      - ci_samples_openthread
    platform_allow:
      - nrf52840dk/nrf52840
    extra_args:
      - cli_SNIPPET=ci
      - CONFIG_NRF_SECURITY=y
    integration_platforms:
      - nrf52840dk/nrf52840
  sample.openthread.cli.tcat:
    sysbuild: true
    build_only: true
    tags:
      - ci_build
      - sysbuild
      - ci_samples_openthread
    platform_allow:
      - nrf52840dk/nrf52840
      - nrf21540dk/nrf52840
      - nrf5340dk/nrf5340/cpuapp
      - nrf54l15dk/nrf54l15/cpuapp
      - nrf54l15dk/nrf54l10/cpuapp
      - nrf54l15dk/nrf54l15/cpuapp/ns
    extra_args:
      - cli_SNIPPET="ci;tcat;tcp"
      - CONFIG_OTPERF=y
      - FILE_SUFFIX=ble
    integration_platforms:
      - nrf52840dk/nrf52840
      - nrf21540dk/nrf52840
      - nrf5340dk/nrf5340/cpuapp
      - nrf54l15dk/nrf54l15/cpuapp
      - nrf54l15dk/nrf54l10/cpuapp
      - nrf54l15dk/nrf54l15/cpuapp/ns
  sample.openthread.cli.diag_gpio:
    sysbuild: true
    build_only: true
    tags:
      - ci_build
      - sysbuild
      - ci_samples_openthread
    platform_allow:
      - nrf52840dk/nrf52840
      - nrf5340dk/nrf5340/cpuapp
      - nrf54l15dk/nrf54l15/cpuapp
      - nrf54l15dk/nrf54l10/cpuapp
      - nrf54l15dk/nrf54l15/cpuapp/ns
    extra_args: >
      cli_SNIPPET=diag_gpio
    integration_platforms:
      - nrf52840dk/nrf52840
      - nrf5340dk/nrf5340/cpuapp
      - nrf54l15dk/nrf54l15/cpuapp
      - nrf54l15dk/nrf54l10/cpuapp
      - nrf54l15dk/nrf54l15/cpuapp/ns
  sample.openthread.cli.l2:
    sysbuild: true
    build_only: true
    tags:
      - ci_build
      - sysbuild
      - ci_samples_openthread
    platform_allow:
      - nrf52840dk/nrf52840
      - nrf5340dk/nrf5340/cpuapp
      - nrf54l15dk/nrf54l15/cpuapp
      - nrf54l15dk/nrf54l10/cpuapp
      - nrf54lm20dk/nrf54lm20a/cpuapp
      - nrf54l15dk/nrf54l15/cpuapp/ns
    extra_args:
      - cli_SNIPPET="ci;l2;ci_l2"
    integration_platforms:
      - nrf52840dk/nrf52840
      - nrf5340dk/nrf5340/cpuapp
      - nrf54l15dk/nrf54l15/cpuapp
      - nrf54l15dk/nrf54l10/cpuapp
      - nrf54lm20dk/nrf54lm20a/cpuapp
      - nrf54l15dk/nrf54l15/cpuapp/ns
  sample.openthread.cli.multiprotocol.l2:
    sysbuild: true
    build_only: true
    tags:
      - ci_build
      - sysbuild
      - ci_samples_openthread
    platform_allow:
      - nrf52840dk/nrf52840
      - nrf5340dk/nrf5340/cpuapp
      - nrf54l15dk/nrf54l15/cpuapp
      - nrf54l15dk/nrf54l10/cpuapp
      - nrf54lm20dk/nrf54lm20a/cpuapp
      - nrf54l15dk/nrf54l15/cpuapp/ns
    extra_args:
      - cli_SNIPPET="ci;logging;multiprotocol;tcp;l2;ci_l2;logging_l2"
      - FILE_SUFFIX=ble
    integration_platforms:
      - nrf52840dk/nrf52840
      - nrf5340dk/nrf5340/cpuapp
      - nrf54l15dk/nrf54l15/cpuapp
      - nrf54l15dk/nrf54l10/cpuapp
      - nrf54lm20dk/nrf54lm20a/cpuapp
      - nrf54l15dk/nrf54l15/cpuapp/ns
```

## prj.conf
```kconfig
#
# Copyright (c) 2020 Nordic Semiconductor
#
# SPDX-License-Identifier: LicenseRef-Nordic-5-Clause
#

# Enable OpenThread
CONFIG_OPENTHREAD=y

# Network shell
CONFIG_SHELL=y
CONFIG_OPENTHREAD_SHELL=y
CONFIG_SHELL_ARGC_MAX=26
CONFIG_SHELL_CMD_BUFF_SIZE=416

# Enable OpenThread features set
CONFIG_OPENTHREAD_NORDIC_LIBRARY_MASTER=y

CONFIG_GPIO_SHELL=y
CONFIG_OPENTHREAD_SOURCES=y
```

## hdr_test.conf
```kconfig
CONFIG_OPENTHREAD_SOURCES=y
CONFIG_OPENTHREAD_RADIO_2P4GHZ_HDR_SUPPORT=y
CONFIG_OPENTHREAD_RADIO_2P4GHZ_HDR_VARIANT_1_PHY_ONLY=y

CONFIG_OPENTHREAD_RADIO_2P4GHZ_HDR_DRY_RUN=y

# Enable Zephyr logging
CONFIG_LOG=y

# Use separate thread for logging
CONFIG_LOG_MODE_DEFERRED=y

# Increase max log level to informative
CONFIG_LOG_MAX_LEVEL=3

# Option for configuring log level in this sample
CONFIG_OT_COMMAND_LINE_INTERFACE_LOG_LEVEL_INF=y

# Enable OpenThread logging
CONFIG_OPENTHREAD_DEBUG=y
# Option for configuring log level in OpenThread
CONFIG_OPENTHREAD_LOG_LEVEL_INFO=y

CONFIG_LOG_BACKEND_UART=y
CONFIG_SHELL_LOG_BACKEND=n

CONFIG_LOG_BUFFER_SIZE=40960
CONFIG_LOG_SPEED=y
```

## boards/nrf54l15pdk_nrf54l15_cpuapp.conf
```kconfig
#
# Copyright (c) 2024 Nordic Semiconductor ASA
#
# SPDX-License-Identifier: LicenseRef-Nordic-5-Clause
#

CONFIG_FPU=n
CONFIG_PM=n
CONFIG_PRINTK_SYNC=y
CONFIG_HWINFO_NRF=n

CONFIG_NRF_802154_TEMPERATURE_UPDATE=n
```

## boards/nrf54l15pdk_nrf54l15_cpuapp_ns.conf
```kconfig
#
# Copyright (c) 2024 Nordic Semiconductor
#
# SPDX-License-Identifier: LicenseRef-Nordic-5-Clause
#

CONFIG_GPIO_SHELL=n

CONFIG_NRF_802154_TEMPERATURE_UPDATE=n

# SECURE FAULT DEBUG
CONFIG_MPSL_BUILD_TYPE_SRC_DEBUG=y
CONFIG_LOG=y
CONFIG_IEEE802154_NRF5_RX_STACK_SIZE=832
CONFIG_LOG_MODE_DEFERRED=y
CONFIG_LOG_MAX_LEVEL=3
CONFIG_OT_COMMAND_LINE_INTERFACE_LOG_LEVEL_INF=y
CONFIG_OPENTHREAD_DEBUG=y
CONFIG_OPENTHREAD_LOG_LEVEL_INFO=y
CONFIG_LOG_BACKEND_UART=y
CONFIG_MAIN_STACK_SIZE=8192
CONFIG_MPSL_WORK_STACK_SIZE=2048
CONFIG_ASSERT=y
```

## boards/nrf52840dongle_nrf52840.overlay
```dts
/* Copyright (c) 2024 Nordic Semiconductor ASA
 *
 * SPDX-License-Identifier: LicenseRef-Nordic-5-Clause
 */

&uart0 {
	status = "okay";
	hw-flow-control;
	current-speed = <1000000>;
};

/ {
	/*
	 * nRF52840 dongle has pin P0.19 connected to reset. By setting it
	 * in `GPIO_OUTPUT_ACTIVE` mode, reset is pulled to GND,
	 * which results in device rebooting without skipping the bootloader.
	 * openthread_config node enables doing so using `ot reset bootloader` command.
	 */
	openthread_config: openthread {
		compatible = "openthread,config";
		bootloader-gpios = <&gpio0 19 GPIO_ACTIVE_LOW>;
	};
};
```

## boards/nrf54l15dk_nrf54l15_cpuapp.overlay
```dts
/*
 * Copyright (c) 2024 Nordic Semiconductor ASA
 *
 * SPDX-License-Identifier: LicenseRef-Nordic-5-Clause
 */

&uart20 {
	current-speed = <1000000>;
};

// restore full RRAM and SRAM space - by default some parts are dedicated to FLPR
&cpuapp_rram {
	reg = <0x0 DT_SIZE_K(1524)>;
};

&cpuapp_sram {
	reg = <0x20000000 DT_SIZE_K(256)>;
	ranges = <0x0 0x20000000 DT_SIZE_K(256)>;
};
```

## boards/nrf54l15pdk_nrf54l15_cpuapp.overlay
```dts
/*
 * Copyright (c) 2024 Nordic Semiconductor ASA
 *
 * SPDX-License-Identifier: LicenseRef-Nordic-5-Clause
 */

// TODO: re-enable HWFC once it's fixed
&uart20 {
	/delete-property/ hw-flow-control;
};
```

## boards/nrf54l15pdk_nrf54l15_cpuapp_ns.overlay
```dts
/*
 * Copyright (c) 2024 Nordic Semiconductor ASA
 *
 * SPDX-License-Identifier: LicenseRef-Nordic-5-Clause
 */

// restore full RRAM and SRAM space - by default some parts are dedicated to FLRP
&cpuapp_rram {
	reg = <0x0 DT_SIZE_K(1524)>;
};

&cpuapp_sram {
	reg = <0x20000000 DT_SIZE_K(256)>;
	ranges = <0x0 0x20000000  0x40000>;
};

// TODO: re-enable HWFC once it's fixed
&uart20 {
	/delete-property/ hw-flow-control;
};
```

## boards/nrf54lm20dk_nrf54lm20a_cpuapp.overlay
```dts
/*
 * Copyright (c) 2024 Nordic Semiconductor ASA
 *
 * SPDX-License-Identifier: LicenseRef-Nordic-5-Clause
 */

&uart20 {
	current-speed = <1000000>;
};
```

## src/main.c
```c
/*
 * Copyright (c) 2020 Nordic Semiconductor ASA
 *
 * SPDX-License-Identifier: LicenseRef-Nordic-5-Clause
 */

#include <zephyr/kernel.h>
#include <zephyr/logging/log.h>

#if defined(CONFIG_CLI_SAMPLE_MULTIPROTOCOL)
#include "ble.h"
#endif

#if defined(CONFIG_CLI_SAMPLE_LOW_POWER)
#include "low_power.h"
#endif

#if defined(CONFIG_CLI_SAMPLE_AUTOSTART)
#include <openthread.h>
#include <openthread/thread.h>
#include <openthread/link.h>
#endif

#include <zephyr/drivers/uart.h>

LOG_MODULE_REGISTER(cli_sample, CONFIG_OT_COMMAND_LINE_INTERFACE_LOG_LEVEL);

#define WELLCOME_TEXT                                                                              \
	"\n\r"                                                                                     \
	"\n\r"                                                                                     \
	"OpenThread Command Line Interface is now running.\n\r"                                    \
	"Use the 'ot' keyword to invoke OpenThread commands e.g. "                                 \
	"'ot thread start.'\n\r"                                                                   \
	"For the full commands list refer to the OpenThread CLI "                                  \
	"documentation at:\n\r"                                                                    \
	"https://github.com/openthread/openthread/blob/master/src/cli/README.md\n\r"

int main(void)
{
#if DT_NODE_HAS_COMPAT(DT_CHOSEN(zephyr_shell_uart), zephyr_cdc_acm_uart)
	int ret;
	const struct device *dev;
	uint32_t dtr = 0U;

	dev = DEVICE_DT_GET(DT_CHOSEN(zephyr_shell_uart));
	if (dev == NULL) {
		LOG_ERR("Failed to find specific UART device");
		return 0;
	}

	LOG_INF("Waiting for host to be ready to communicate");

	/* Data Terminal Ready - check if host is ready to communicate */
	while (!dtr) {
		ret = uart_line_ctrl_get(dev, UART_LINE_CTRL_DTR, &dtr);
		if (ret) {
			LOG_ERR("Failed to get Data Terminal Ready line state: %d", ret);
			continue;
		}
		k_msleep(100);
	}

	/* Data Carrier Detect Modem - mark connection as established */
	(void)uart_line_ctrl_set(dev, UART_LINE_CTRL_DCD, 1);
	/* Data Set Ready - the NCP SoC is ready to communicate */
	(void)uart_line_ctrl_set(dev, UART_LINE_CTRL_DSR, 1);
#endif

	LOG_INF(WELLCOME_TEXT);

#if defined(CONFIG_CLI_SAMPLE_MULTIPROTOCOL)
	ble_enable();
#endif

#if defined(CONFIG_CLI_SAMPLE_LOW_POWER)
	low_power_enable();
#endif

#if defined(CONFIG_CLI_SAMPLE_AUTOSTART)
	otInstance *instance = openthread_get_default_instance();
	if (instance == NULL) {
		LOG_ERR("Failed to get OpenThread instance");
		return -1;
	}

	// Set the channel
	uint8_t channel = 23;
	otError err = otLinkSetChannel(instance, channel);
	if (err != OT_ERROR_NONE) {
		LOG_ERR("Failed to set channel: %d", err);
	}

	// Set network key
	const uint8_t networkKey[] = {0x11, 0x22, 0x33, 0x44, 0x55, 0x66, 0x77, 0x88,
				      0x99, 0xaa, 0xbb, 0xcc, 0xdd, 0xee, 0xff, 0x00};
	err = otThreadSetNetworkKey(instance, (const otNetworkKey *)networkKey);
	if (err != OT_ERROR_NONE) {
		LOG_ERR("Failed to set network key: %d", err);
	}

	// Set PAN ID
	otPanId panid = 0x1234;
	err = otLinkSetPanId(instance, panid);
	if (err != OT_ERROR_NONE) {
		LOG_ERR("Failed to set PAN ID: %d", err);
	}

	openthread_run();

#endif

	return 0;
}
```

## src/low_power.c
```c
/*
 * Copyright (c) 2023 Nordic Semiconductor ASA
 *
 * SPDX-License-Identifier: LicenseRef-Nordic-5-Clause
 */

#include <openthread.h>
#include <openthread/thread.h>
#include <zephyr/device.h>
#include <zephyr/pm/device.h>
#if defined(CONFIG_RAM_POWER_DOWN_LIBRARY)
#include <ram_pwrdn.h>
#endif

#include "low_power.h"

static void on_thread_state_changed(otChangedFlags flags, void *user_data)
{
	struct otInstance *instance = openthread_get_default_instance();

	if (flags & OT_CHANGED_THREAD_ROLE) {
		if (otThreadGetDeviceRole(instance) == OT_DEVICE_ROLE_CHILD) {
			const struct device *cons = DEVICE_DT_GET(DT_CHOSEN(zephyr_console));

			if (!device_is_ready(cons)) {
				return;
			}

			pm_device_action_run(cons, PM_DEVICE_ACTION_SUSPEND);
#if defined(CONFIG_RAM_POWER_DOWN_LIBRARY)
			power_down_unused_ram();
#endif
		}
	}
}

static struct openthread_state_changed_callback ot_state_chaged_cb = {
	.otCallback = on_thread_state_changed};

void low_power_enable(void)
{
	// openthread_state_changed_callback_register(&ot_state_chaged_cb);
}
```
